## conf/layer.conf
```bitbake
# We have a conf and classes directory, add to BBPATH
BBPATH .= ":${LAYERDIR}"

# We have recipes-* directories, add to BBFILES
BBFILES += "${LAYERDIR}/recipes-*/*/*.bb \
            ${LAYERDIR}/recipes-*/*/*.bbappend"

BBFILE_COLLECTIONS += "meta-kdab"
BBFILE_PATTERN_meta-kdab = "^${LAYERDIR}/"
BBFILE_PRIORITY_meta-kdab = "6"

LAYERDEPENDS_meta-kdab = "core"
LAYERSERIES_COMPAT_meta-kdab = "scarthgap"
```
